/* USER CODE BEGIN Header */
/**
  ******************************************************************************
  * @file           : main.c
  * @brief          : Main program body
  ******************************************************************************
  * @attention
  *
  * <h2><center>&copy; Copyright (c) 2022 STMicroelectronics.
  * All rights reserved.</center></h2>
  *
  * This software component is licensed by ST under Ultimate Liberty license
  * SLA0044, the "License"; You may not use this file except in compliance with
  * the License. You may obtain a copy of the License at:
  *                             www.st.com/SLA0044
  *
  ******************************************************************************
  */
/* USER CODE END Header */
/* Includes ------------------------------------------------------------------*/
#include "main.h"
#include "cmsis_os.h"
#include "can.h"
#include "dma.h"
#include "spi.h"
#include "tim.h"
#include "usart.h"
#include "gpio.h"

/* Private includes ----------------------------------------------------------*/
/* USER CODE BEGIN Includes */
#include "bsp_rc.h"
#include "Stepper.h"
#include "chassis_task.h"
#include "display.h"
#include "Moto.h"
#include "pid.h"
#include "remote_control.h"
#include "sys.h"
#include "TFT20_ILI9225.h"
#include "ff.h"
#include "sdio_sdcard.h"
#include "PVD.h"
#include "bkp_sram.h"
#include "stdio.h"
#include "command.h"
/* USER CODE END Includes */

/* Private typedef -----------------------------------------------------------*/
/* USER CODE BEGIN PTD */
const unsigned char QiQ[] = { 80 , 80,/* 0X00,0X10,0X50,0X00,0X50,0X00,0X01,0X1B, */
0XFF,0XFF,0XFF,0XFF,0XFF,0XFF,0XFF,0XFF,0XFF,0XFF,0XFF,0XFF,0XFF,0XFF,0XFF,0XFF,
0XFF,0XFF,0XFF,0XFF,0XFF,0XFF,0XFF,0XFF,0XFF,0XFF,0XFF,0XFF,0XFF,0XFF,0XFF,0XFF,
0XFF,0XFF,0XFF,0XFF,0XFF,0XFF,0XFF,0XFF,0XFF,0XFF,0XFF,0XFF,0XFF,0XFF,0XFF,0XFF,
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0XFF,0XFF,0XFF,0XFF,0XFF,0XFF,0XFF,0XFF,0XFF,0XFF,0XFF,0XFF,0XFF,0XFF,0XFF,0XFF,
};


/* USER CODE END PTD */

/* Private define ------------------------------------------------------------*/
/* USER CODE BEGIN PD */
/* USER CODE END PD */

/* Private macro -------------------------------------------------------------*/
/* USER CODE BEGIN PM */

/* USER CODE END PM */

/* Private variables ---------------------------------------------------------*/

/* USER CODE BEGIN PV */

/* USER CODE END PV */

/* Private function prototypes -----------------------------------------------*/
void SystemClock_Config(void);
void MX_FREERTOS_Init(void);
/* USER CODE BEGIN PFP */

/* USER CODE END PFP */

/* Private user code ---------------------------------------------------------*/
/* USER CODE BEGIN 0 */
/***********************************************************
函数名：Stepper_SetZero
功能：寻找pitch轴零点
参数：void
***********************************************************/
int Stepper_SetZero()
 {
	 int state=0;
	 STEP_ENABLE(&stepper1);
	 HAL_GPIO_WritePin(stepper1.DIR_GPIO,stepper1.DIR_Pin,STEPPER_COUNTERCLOCKWISE);
	while(state==0) 
		{
			if(HAL_GPIO_ReadPin(GPIOI,GPIO_PIN_0)==0) state=1;   //正常退出
			else if(HAL_GPIO_ReadPin(GPIOB,GPIO_PIN_2)==1) state=2;  //按键跳过
			HAL_GPIO_TogglePin(stepper1.PUL_GPIO,stepper1.PUL_Pin);
			HAL_Delay(1);
		}
	STEP_SetZero(&stepper1);
		stepper1.sum_Step=0;
		return state;
 }
/***********************************************************
函数名：Pitch_Init
功能：Pitch轴初始化
参数：void
***********************************************************/
void Pitch_Init()
 {
	TFT20_DrawFont_GBK16(0,118,WHITE,BLACK,"Set_StepperZero...");
	TFT20_DrawFont_GBK16(0,134,YELLOW,BLACK,"Press KEY to Skip SetZero!!");
	switch (Stepper_SetZero())
	{
		case 1: TFT20_DrawFont_GBK16(144,118,GREEN,BLACK,"Complete"); break;
		case 2: TFT20_DrawFont_GBK16(144,118,YELLOW,BLACK,"Skip"); break;
		default: TFT20_DrawFont_GBK16(144,118,RED,BLACK,"ERROR"); break;
	}
	TFT20_DrawFont_GBK16(0,134,YELLOW,BLACK,"                           ");
 }
 /***********************************************************
函数名：BSP_Init
功能：板载外设初始化,上电后自检流程
参数：void
***********************************************************/
void BSP_Init()
{
	TFT20_Init();
	TFT20_Clear(BLACK);
	TFT20_SetRegion(0,0,220,176);
	TFT20_DrawFont_GBK16(0,0,WHITE,BLACK,"Initialling...");
	
	TFT20_DrawFont_GBK16(0,18,WHITE,BLACK,"Stepper_Init...");
	Stepper_Init(&stepper1,1.8,1,GPIOH,GPIO_PIN_12,GPIOH,GPIO_PIN_11,GPIOH,GPIO_PIN_10);
	TFT20_DrawFont_GBK16(120,18,GREEN,BLACK,"Success");
	
	TFT20_DrawFont_GBK16(0,36,WHITE,BLACK,"Set_DBUS...");
	remote_control_init();
	TFT20_DrawFont_GBK16(88,36,GREEN,BLACK,"Complete");
	
	
	TFT20_DrawFont_GBK16(0,54,WHITE,BLACK,"CAN_Set...");
	CAN_Filter_Init(&hcan1);
	CAN_Filter_Init(&hcan2);
	HAL_CAN_ActivateNotification(&hcan1, CAN_IT_RX_FIFO0_MSG_PENDING);
	HAL_CAN_ActivateNotification(&hcan2, CAN_IT_RX_FIFO0_MSG_PENDING);
	TFT20_DrawFont_GBK16(80,54,GREEN,BLACK,"Complete");
	
	TFT20_DrawFont_GBK16(0,72,WHITE,BLACK,"Set_SD_Card...");
	if(SD_NOT_Exist) TFT20_DrawFont_GBK16(112,72,YELLOW,BLACK,"Not Exist");
	else 
	{
		if(SD_Insert())TFT20_DrawFont_GBK16(112,72,RED,BLACK,"Failed");
		else TFT20_DrawFont_GBK16(112,72,GREEN,BLACK,"Success");
	}
	
	TFT20_DrawFont_GBK16(0,90,WHITE,BLACK,"Load config...");
	if(SD_exist)
	{
		if(Para_Load()) TFT20_DrawFont_GBK16(112,90,RED,BLACK,"Failed");
		else TFT20_DrawFont_GBK16(112,90,GREEN,BLACK,"Success");
	}
	
	BKP_SRAM_Init();
	if(BKP_Handler->updatemark == 1) Run_recv();  //从备份域恢复
	else
	{
		if(SD_exist)
		{
			if(Data_Load()) Pitch_Init();
			else Run_recv();                         //从SD卡恢复
		}
		else 
		{
			BKP_Handler->RunMode = RunMode;
			Pitch_Init();
		}
	}
	
	PVD_Config(PWR_PVDLEVEL_6);
	
	while(HAL_CAN_Start(&hcan1) != HAL_OK );
	while(HAL_CAN_Start(&hcan2) != HAL_OK );
	
	HAL_GPIO_WritePin(GPIOH,GPIO_PIN_2|GPIO_PIN_3|GPIO_PIN_4|GPIO_PIN_5,GPIO_PIN_SET);//开启24V电源
	
	
	HAL_Delay(500);
	
	TFT20_Clear(BLACK);
}
/* USER CODE END 0 */

/**
  * @brief  The application entry point.
  * @retval int
  */
int main(void)
{
  /* USER CODE BEGIN 1 */

  /* USER CODE END 1 */

  /* MCU Configuration--------------------------------------------------------*/

  /* Reset of all peripherals, Initializes the Flash interface and the Systick. */
  HAL_Init();

  /* USER CODE BEGIN Init */

  /* USER CODE END Init */

  /* Configure the system clock */
  SystemClock_Config();

  /* USER CODE BEGIN SysInit */
	CircleBuf_Init(&uartbuf,150);
  /* USER CODE END SysInit */

  /* Initialize all configured peripherals */
  MX_GPIO_Init();
  MX_DMA_Init();
  MX_CAN1_Init();
  MX_SPI1_Init();
  MX_USART1_UART_Init();
  MX_UART8_Init();
  MX_CAN2_Init();
  MX_TIM1_Init();
  MX_USART6_UART_Init();
  /* USER CODE BEGIN 2 */
	BSP_Init();
  /* USER CODE END 2 */

  /* Init scheduler */
  osKernelInitialize();  /* Call init function for freertos objects (in freertos.c) */
  MX_FREERTOS_Init();
  /* Start scheduler */
  osKernelStart();

  /* We should never get here as control is now taken by the scheduler */
  /* Infinite loop */
  /* USER CODE BEGIN WHILE */
  while (1)
  {
    /* USER CODE END WHILE */

    /* USER CODE BEGIN 3 */
  }
  /* USER CODE END 3 */
}

/**
  * @brief System Clock Configuration
  * @retval None
  */
void SystemClock_Config(void)
{
  RCC_OscInitTypeDef RCC_OscInitStruct = {0};
  RCC_ClkInitTypeDef RCC_ClkInitStruct = {0};

  /** Configure the main internal regulator output voltage
  */
  __HAL_RCC_PWR_CLK_ENABLE();
  __HAL_PWR_VOLTAGESCALING_CONFIG(PWR_REGULATOR_VOLTAGE_SCALE1);
  /** Initializes the RCC Oscillators according to the specified parameters
  * in the RCC_OscInitTypeDef structure.
  */
  RCC_OscInitStruct.OscillatorType = RCC_OSCILLATORTYPE_HSE;
  RCC_OscInitStruct.HSEState = RCC_HSE_ON;
  RCC_OscInitStruct.PLL.PLLState = RCC_PLL_ON;
  RCC_OscInitStruct.PLL.PLLSource = RCC_PLLSOURCE_HSE;
  RCC_OscInitStruct.PLL.PLLM = 8;
  RCC_OscInitStruct.PLL.PLLN = 240;
  RCC_OscInitStruct.PLL.PLLP = RCC_PLLP_DIV2;
  RCC_OscInitStruct.PLL.PLLQ = 15;
  if (HAL_RCC_OscConfig(&RCC_OscInitStruct) != HAL_OK)
  {
    Error_Handler();
  }
  /** Activate the Over-Drive mode
  */
  if (HAL_PWREx_EnableOverDrive() != HAL_OK)
  {
    Error_Handler();
  }
  /** Initializes the CPU, AHB and APB buses clocks
  */
  RCC_ClkInitStruct.ClockType = RCC_CLOCKTYPE_HCLK|RCC_CLOCKTYPE_SYSCLK
                              |RCC_CLOCKTYPE_PCLK1|RCC_CLOCKTYPE_PCLK2;
  RCC_ClkInitStruct.SYSCLKSource = RCC_SYSCLKSOURCE_PLLCLK;
  RCC_ClkInitStruct.AHBCLKDivider = RCC_SYSCLK_DIV1;
  RCC_ClkInitStruct.APB1CLKDivider = RCC_HCLK_DIV4;
  RCC_ClkInitStruct.APB2CLKDivider = RCC_HCLK_DIV2;

  if (HAL_RCC_ClockConfig(&RCC_ClkInitStruct, FLASH_LATENCY_5) != HAL_OK)
  {
    Error_Handler();
  }
}

/* USER CODE BEGIN 4 */
//printf输出重定向
int fputc(int ch, FILE* stream)
{
	uint8_t tmp=ch;
	HAL_UART_Transmit(&huart8,&tmp,1,100);
	return ch;
}

//线中断回调
void HAL_GPIO_EXTI_Callback(uint16_t Pin)
{
	if(Pin == GPIO_PIN_15) SD_Insert();
	else if(Pin == GPIO_PIN_14) Measure_EXT1_Process();
	else if(Pin == GPIO_PIN_13) Measure_EXT2_Process();
}
/* USER CODE END 4 */

 /**
  * @brief  Period elapsed callback in non blocking mode
  * @note   This function is called  when TIM2 interrupt took place, inside
  * HAL_TIM_IRQHandler(). It makes a direct call to HAL_IncTick() to increment
  * a global variable "uwTick" used as application time base.
  * @param  htim : TIM handle
  * @retval None
  */
void HAL_TIM_PeriodElapsedCallback(TIM_HandleTypeDef *htim)
{
  /* USER CODE BEGIN Callback 0 */
	
  /* USER CODE END Callback 0 */
  if (htim->Instance == TIM2) {
    HAL_IncTick();
  }
  /* USER CODE BEGIN Callback 1 */
	else if (htim->Instance == TIM1) 
		{
			
		}
  /* USER CODE END Callback 1 */
}

/**
  * @brief  This function is executed in case of error occurrence.
  * @retval None
  */
void Error_Handler(void)
{
  /* USER CODE BEGIN Error_Handler_Debug */
  /* User can add his own implementation to report the HAL error return state */
  __disable_irq();
	
	HAL_NVIC_SystemReset();   //出错后复位
  while (1)
  {
  }
  /* USER CODE END Error_Handler_Debug */
}

#ifdef  USE_FULL_ASSERT
/**
  * @brief  Reports the name of the source file and the source line number
  *         where the assert_param error has occurred.
  * @param  file: pointer to the source file name
  * @param  line: assert_param error line source number
  * @retval None
  */
void assert_failed(uint8_t *file, uint32_t line)
{
  /* USER CODE BEGIN 6 */
  /* User can add his own implementation to report the file name and line number,
     ex: printf("Wrong parameters value: file %s on line %d\r\n", file, line) */
  /* USER CODE END 6 */
}
#endif /* USE_FULL_ASSERT */

/************************ (C) COPYRIGHT STMicroelectronics *****END OF FILE****/
